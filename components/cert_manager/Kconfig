## components/cert_manager/Kconfig
```kconfig
# Certificate Manager Configuration
# Implements SEC-026: ThermoFlow HTTPS Web Server

menu "Certificate Manager Configuration"

    config CERT_MANAGER_ENABLED
        bool "Enable Certificate Manager"
        default y
        help
            Enable certificate lifecycle management for HTTPS.
            Required for SEC-026 compliance.

    config CERT_MANAGER_AUTO_RENEWAL
        bool "Enable Automatic Certificate Renewal"
        default y
        depends on CERT_MANAGER_ENABLED
        help
            Automatically renew certificates before expiry.
            Recommended for production use.

    config CERT_MANAGER_RENEWAL_DAYS
        int "Renewal Threshold (days)"
        default 30
        range 1 90
        depends on CERT_MANAGER_ENABLED && CERT_MANAGER_AUTO_RENEWAL
        help
            Renew certificate when this many days remain.
            Default: 30 days before expiry.

    config CERT_MANAGER_KEY_SIZE
        int "RSA Key Size (bits)"
        default 2048
        range 2048 4096
        depends on CERT_MANAGER_ENABLED
        help
            RSA key size for certificate generation.
            2048 bits recommended for ESP32-S3.

    config CERT_MANAGER_EJBCA_INTEGRATION
        bool "Enable EJBCA Integration"
        default n
        depends on CERT_MANAGER_ENABLED
        help
            Enable automatic certificate enrollment with EJBCA-PKI.
            Requires EJBCA server configuration.

    config CERT_MANAGER_EJBCA_URL
        string "EJBCA Server URL"
        default "https://ejbca.lttsweden.local:8443"
        depends on CERT_MANAGER_ENABLED && CERT_MANAGER_EJBCA_INTEGRATION
        help
            URL of the EJBCA-PKI server.

    config CERT_MANAGER_DEVICE_ID
        string "Device ID Prefix"
        default "ThermoFlow"
        depends on CERT_MANAGER_ENABLED
        help
            Prefix for device certificate CN.
            MAC address will be appended.

endmenu
```

## components/mqtt_client/Kconfig
```kconfig
# MQTT-TLS Configuration for ThermoFlow
# Implements SEC-016: Critical Security Remediation

menu "MQTT-TLS Configuration"

    config MQTT_TLS_ENABLED
        bool "Enable MQTT over TLS (MQTTS)"
        default y
        help
            Enable TLS encryption for MQTT connections.
            This is HIGHLY RECOMMENDED for production use.
            
            Disabling this will send all MQTT traffic, including
            credentials and sensor data, in plaintext.

    config MQTT_TLS_PORT
        int "MQTTS Port"
        default 8883
        depends on MQTT_TLS_ENABLED
        help
            Port for MQTT over TLS connections.
            Standard port is 8883.

    choice MQTT_TLS_VERSION
        prompt "Minimum TLS Version"
        default MQTT_TLS_VERSION_1_3
        depends on MQTT_TLS_ENABLED
        help
            Select minimum TLS version.
            TLS 1.3 is recommended for best security.

        config MQTT_TLS_VERSION_1_2
            bool "TLS 1.2"
            help
                Use TLS 1.2 (legacy compatibility mode)

        config MQTT_TLS_VERSION_1_3
            bool "TLS 1.3"
            help
                Use TLS 1.3 (recommended - best security)
    endchoice

    config MQTT_TLS_MIN_VERSION
        int
        default 2 if MQTT_TLS_VERSION_1_2
        default 3 if MQTT_TLS_VERSION_1_3

    config MQTT_TLS_SERVER_VERIFICATION
        bool "Enable Server Certificate Verification"
        default y
        depends on MQTT_TLS_ENABLED
        help
            Verify MQTT broker's certificate against CA.
            Disabling this allows man-in-the-middle attacks.

    config MQTT_TLS_HOSTNAME_CHECK
        bool "Enable Hostname Verification"
        default y
        depends on MQTT_TLS_ENABLED
        help
            Verify broker certificate hostname matches configured host.

    config MQTT_TLS_CERT_PINNING
        bool "Enable Certificate Pinning"
        default n
        depends on MQTT_TLS_ENABLED
        help
            Pin to specific certificate hash for additional security.
            Requires the pinned certificate hash to be set at runtime.

    config MQTT_TLS_MTLS
        bool "Enable Client Certificate Authentication (mTLS)"
        default n
        depends on MQTT_TLS_ENABLED
        help
            Use client certificates for mutual TLS authentication.
            Requires client certificate and private key provisioning.

    config MQTT_TLS_ALLOW_PLAINTEXT_FALLBACK
        bool "Allow Plaintext Fallback (INSECURE)"
        default n
        depends on MQTT_TLS_ENABLED
        help
            FALLBACK TO PLAINTEXT MQTT IF TLS FAILS.
            
            WARNING: This creates a security vulnerability!
            An attacker can force downgrade to plaintext.
            Only enable for development/debugging.

    config MQTT_TLS_CA_CERT_EMBED
        bool "Embed CA Certificate in Firmware"
        default n
        depends on MQTT_TLS_ENABLED
        help
            Include CA certificate in firmware binary.
            Alternative to loading from NVS at runtime.

    config MQTT_TLS_CA_CERT_PATH
        string "Path to CA Certificate PEM"
        default ""
        depends on MQTT_TLS_ENABLED && MQTT_TLS_CA_CERT_EMBED
        help
            File path to CA certificate in PEM format.
            Will be embedded as a string constant.

    config MQTT_TLS_CONNECTION_TIMEOUT_MS
        int "TLS Connection Timeout (ms)"
        default 10000
        range 5000 60000
        depends on MQTT_TLS_ENABLED
        help
            Timeout for TLS handshake in milliseconds.

    config MQTT_TLS_RX_BUFFER_SIZE
        int "TLS RX Buffer Size"
        default 4096
        range 1024 16384
        depends on MQTT_TLS_ENABLED
        help
            Size of TLS receive buffer.

    config MQTT_TLS_TX_BUFFER_SIZE
        int "TLS TX Buffer Size"
        default 4096
        range 1024 16384
        depends on MQTT_TLS_ENABLED
        help
            Size of TLS transmit buffer.

    config MQTT_TLS_RECONNECT_DELAY_MS
        int "Initial Reconnect Delay (ms)"
        default 1000
        range 100 10000
        depends on MQTT_TLS_ENABLED
        help
            Initial delay before reconnection attempt.

    config MQTT_TLS_MAX_RECONNECT_DELAY_MS
        int "Maximum Reconnect Delay (ms)"
        default 30000
        range 5000 300000
        depends on MQTT_TLS_ENABLED
        help
            Maximum delay between reconnection attempts (exponential backoff).

endmenu

menu "MQTT Protocol Configuration"

    config MQTT_MAX_SUBSCRIPTIONS
        int "Maximum Subscriptions"
        default 8
        range 1 32
        help
            Maximum number of MQTT subscriptions per client.

    config MQTT_KEEPALIVE_INTERVAL_SEC
        int "Keepalive Interval (seconds)"
        default 60
        range 10 600
        help
            Interval between MQTT keepalive pings.

    config MQTT_PUBLISH_QOS
        int "Default Publish QoS"
        default 1
        range 0 2
        help
            Default Quality of Service level for publishes.
            0 = At most once, 1 = At least once, 2 = Exactly once.

endmenu
```

## components/web_server/Kconfig
```kconfig
# HTTPS Web Server Configuration for ThermoFlow
# Implements SEC-018: Security Enhancement - HTTPS Implementation

menu "HTTPS Web Server Configuration"

    config WEB_SERVER_HTTPS_ENABLED
        bool "Enable HTTPS"
        default y
        help
            Enable HTTPS for secure web server communication.
            This is HIGHLY RECOMMENDED for production use.
            
            When disabled, the server will run on unencrypted HTTP only.

    config WEB_SERVER_HTTPS_PORT
        int "HTTPS Port"
        default 443
        depends on WEB_SERVER_HTTPS_ENABLED
        help
            Port for HTTPS server.
            Standard HTTPS port is 443.

    config WEB_SERVER_HTTP_REDIRECT
        bool "Enable HTTP to HTTPS Redirect"
        default y
        depends on WEB_SERVER_HTTPS_ENABLED
        help
            Start HTTP server on port 80 that redirects all requests to HTTPS.
            This ensures clients automatically use secure connections.

    config WEB_SERVER_HTTP_PORT
        int "HTTP Port (for redirect)"
        default 80
        depends on WEB_SERVER_HTTPS_ENABLED && WEB_SERVER_HTTP_REDIRECT
        help
            Port for HTTP redirect server.
            Standard HTTP port is 80.

    choice WEB_SERVER_TLS_VERSION
        prompt "Minimum TLS Version"
        default WEB_SERVER_TLS_VERSION_1_3
        depends on WEB_SERVER_HTTPS_ENABLED
        help
            Select minimum TLS version.
            TLS 1.3 is recommended for best security.

        config WEB_SERVER_TLS_VERSION_1_2
            bool "TLS 1.2 (legacy compatibility)"
            help
                Allow TLS 1.2 connections (less secure but more compatible)

        config WEB_SERVER_TLS_VERSION_1_3
            bool "TLS 1.3 (recommended)"
            help
                Require TLS 1.3 for maximum security
    endchoice

    config WEB_SERVER_TLS_1_3_ONLY
        bool "TLS 1.3 Only (no fallback)"
        default n
        depends on WEB_SERVER_HTTPS_ENABLED
        help
            Require TLS 1.3 and reject older versions.
            More secure but may break compatibility with older clients.

    config WEB_SERVER_ENABLE_MTLS
        bool "Enable Mutual TLS (mTLS)"
        default n
        depends on WEB_SERVER_HTTPS_ENABLED
        help
            Require client certificates for authentication.
            This provides strong mutual authentication.

    config WEB_SERVER_ENABLE_HSTS
        bool "Enable HTTP Strict Transport Security (HSTS)"
        default y
        depends on WEB_SERVER_HTTPS_ENABLED
        help
            Send HSTS header to instruct browsers to always use HTTPS.
            Prevents SSL stripping attacks.

    config WEB_SERVER_HSTS_MAX_AGE
        int "HSTS Max Age (seconds)"
        default 31536000
        depends on WEB_SERVER_HTTPS_ENABLED && WEB_SERVER_ENABLE_HSTS
        help
            How long browsers should remember to use HTTPS.
            Default is 1 year (31536000 seconds).
            Range: 86400 (1 day) to 63072000 (2 years)

    config WEB_SERVER_HSTS_PRELOAD
        bool "Include HSTS Preload"
        default n
        depends on WEB_SERVER_HTTPS_ENABLED && WEB_SERVER_ENABLE_HSTS
        help
            Include the site in browser HSTS preload lists.
            Only enable for production sites that always use HTTPS.

    config WEB_SERVER_ENABLE_CSP
        bool "Enable Content Security Policy"
        default y
        depends on WEB_SERVER_HTTPS_ENABLED
        help
            Send CSP header to prevent XSS and data injection attacks.

    config WEB_SERVER_CSP_POLICY
        string "Content Security Policy"
        default "default-src 'self'; script-src 'self'; style-src 'self' 'unsafe-inline'; img-src 'self' data:; connect-src 'self';"
        depends on WEB_SERVER_HTTPS_ENABLED && WEB_SERVER_ENABLE_CSP
        help
            Content Security Policy string.
            Default is restrictive - modify as needed for your application.

    config WEB_SERVER_AUTO_PROVISION
        bool "Auto-provision Certificates from EJBCA"
        default y
        depends on WEB_SERVER_HTTPS_ENABLED
        help
            Automatically request certificates from EJBCA-PKI on first boot.
            Requires network connectivity and EJBCA server configuration.

    config WEB_SERVER_EJBCA_URL
        string "EJBCA Server URL"
        default "https://ejbca.lttsweden.local:8443"
        depends on WEB_SERVER_HTTPS_ENABLED && WEB_SERVER_AUTO_PROVISION
        help
            URL of the EJBCA-PKI server for certificate provisioning.

    config WEB_SERVER_CERT_DEVICE_ID
        string "Device ID for Certificate CN"
        default ""
        depends on WEB_SERVER_HTTPS_ENABLED
        help
            Common Name (CN) for the device certificate.
            If empty, MAC address will be used as default.
            Example: "ThermoFlow-001" or "ventilation-device-01"

    config WEB_SERVER_CERT_VALIDITY_DAYS
        int "Certificate Validity (days)"
        default 365
        depends on WEB_SERVER_HTTPS_ENABLED
        help
            Validity period for self-signed certificates.
            EJBCA-issued certificates use CA policy instead.

    config WEB_SERVER_CERT_RENEWAL_DAYS
        int "Certificate Renewal Threshold (days)"
        default 30
        depends on WEB_SERVER_HTTPS_ENABLED
        help
            Renew certificate when this many days remain until expiry.
            Allows time to address any renewal issues.

    config WEB_SERVER_TLS_RX_BUFFER_SIZE
        int "TLS RX Buffer Size"
        default 4096
        range 1024 16384
        depends on WEB_SERVER_HTTPS_ENABLED
        help
            Size of TLS receive buffer.

    config WEB_SERVER_TLS_TX_BUFFER_SIZE
        int "TLS TX Buffer Size"
        default 4096
        range 1024 16384
        depends on WEB_SERVER_HTTPS_ENABLED
        help
            Size of TLS transmit buffer.

endmenu
```
